## SCA200X_SDK_V1.3.8_GLIBC/01.software/board/SCA200X_SDK_V1.3.8_GLIBC/osdrv/tools/pc/fwup/firmware_bd2_ipc.its
```
/*
 * Automatic software update for Firmware
 * Make sure the flashing addresses ('load' prop) is correct for your board!
 */

/dts-v1/;

/ {
	description = "smartchip firmware";
	#address-cells = <1>;


	images {

		/* ramdisk: for ext4 sparse */
		//type = "ramdisk";
		//type = "standalone";

		/* mmc blk addr */
		//load = <0x00000000>;

		/* part1: mmc boot0*/
		/* part0: mmc user*/
		//entry = <0x1>;
		//entry = <0x0>;

		update-1 {
			description = "boot";
			data = /incbin/("./ipcImage/boot.img");
			compression = "none";
			type = "standalone";
			arch = "arm64";

			load = <0x00000000>;
			entry = <0x1>;
			hash-1 {
				algo = "sha1";
			};
		};
		update-2 {
			description = "kernel";
			data = /incbin/("./ipcImage/pcid.img");
			compression = "none";
			type = "standalone";
			arch = "arm64";
			os = "linux";

			load = <0x500>;
			entry = <0x0>;
			hash-1 {
				algo = "md5";
			};
		};
		update-3 {
			description = "kernel";
			data = /incbin/("./ipcImage/uImage");
			compression = "none";
			type = "kernel";
			arch = "arm64";
			os = "linux";

			load = <0x800>;
			entry = <0x0>;
			hash-1 {
				algo = "md5";
			};
		};
		update-4 {
			description = "kernel_dtb";
			data = /incbin/("./ipcImage/smartchip-sca200v100-bd2.dtb");
			compression = "none";
			type = "standalone";
			arch = "arm64";
			os = "linux";

			load = <0x3800>;
			entry = <0x0>;
			hash-1 {
				algo = "md5";
			};
		};
		update-5 {
			description = "rootfs";
			data = /incbin/("./ipcImage/rootfs.img.emmc.sparse.img");
			compression = "none";
			type = "ramdisk";
			arch = "arm64";
			os = "linux";

			load = <0x4000>;
			entry = <0x0>;
			hash-1 {
				algo = "md5";
			};
		};
		update-6 {
			description = "log";
			data = /incbin/("./ipcImage/log.img.emmc.sparse.img");
			compression = "none";
			type = "ramdisk";
			arch = "arm64";
			os = "linux";

			load = <0x24000>;
			entry = <0x0>;
			hash-1 {
				algo = "md5";
			};
		};
		update-7 {
			description = "config";
			data = /incbin/("./ipcImage/config.img.emmc.sparse.img");
			compression = "none";
			type = "ramdisk";
			arch = "arm64";
			os = "linux";

			load = <0x38000>;
			entry = <0x0>;
			hash-1 {
				algo = "md5";
			};
		};
		update-8 {
			description = "rootfs_ext";
			data = /incbin/("./ipcImage/rootfs_ext.img.emmc.sparse.img");
			compression = "none";
			type = "ramdisk";
			arch = "arm64";
			os = "linux";

			load = <0x40000>;
			entry = <0x0>;
			hash-1 {
				algo = "md5";
			};
		};
	};
};
```
