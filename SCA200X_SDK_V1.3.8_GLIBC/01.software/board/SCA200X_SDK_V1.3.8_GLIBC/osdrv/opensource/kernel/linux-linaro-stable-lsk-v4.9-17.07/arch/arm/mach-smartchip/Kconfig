## SCA200X_SDK_V1.3.8_GLIBC/01.software/board/SCA200X_SDK_V1.3.8_GLIBC/osdrv/opensource/kernel/linux-linaro-stable-lsk-v4.9-17.07/arch/arm/mach-smartchip/Kconfig
```kconfig
menuconfig ARCH_SMARTCHIP
	bool "SmartChip SoCs"  # if ARCH_MULTI_V7
	select ARCH_REQUIRE_GPIOLIB
	select ARCH_HAS_RESET_CONTROLLER
	select CLKSRC_MMIO
	select GENERIC_IRQ_CHIP
	select PINCTRL
	select RESET_CONTROLLER
	select INLINE_SPIN_UNLOCK_IRQ
if ARCH_SMARTCHIP

config MACH_SMARTX
	bool "SmartChip Smartx SoCs support"
	default ARCH_SMARTCHIP
	select ARM_GIC
	select DW_APB_TIMER_OF

endif
```

## SCA200X_SDK_V1.3.8_GLIBC/01.software/board/SCA200X_SDK_V1.3.8_GLIBC/osdrv/opensource/kernel/linux-linaro-stable-lsk-v4.9-17.07/arch/arm64/Kconfig.smartchip
```kconfig
choice
	prompt "smartchip type"
	depends on ARCH_SMARTCHIP
	default ARCH_SCA200V100
	help
	  smartchip soc type select

config ARCH_SCA200V100
	bool "smartchip sca200v100"
	help
	  This enalbes support for sca200v100

config ARCH_SCA200V200
	bool "smartchip sca200v200"
	help
	  This enalbes support for sca200v200

endchoice
```

## SCA200X_SDK_V1.3.8_GLIBC/01.software/board/SCA200X_SDK_V1.3.8_GLIBC/osdrv/opensource/kernel/linux-linaro-stable-lsk-v4.9-17.07/drivers/iio/imu/inv_mpu6509/Kconfig
```kconfig
#
# inv-mpu6509 drivers for Invensense MPU devices and combos
#

config INV_MPU6509_IIO
	tristate
	select IIO_BUFFER
	select IIO_TRIGGERED_BUFFER

config INV_MPU6509_I2C
	tristate "Invensense MPU6509 devices (I2C)"
	depends on I2C_MUX
	select INV_MPU6509_IIO
	select REGMAP_I2C
	help
	  This driver supports the Invensense MPU6509
	  motion tracking devices over I2C.
	  This driver can be built as a module. The module will be called
	  inv-mpu6509-i2c.

config INV_MPU6509_SPI
	tristate "Invensense MPU6509 devices (SPI)"
	depends on SPI_MASTER
	select INV_MPU6509_IIO
	select REGMAP_SPI
	help
	  This driver supports the Invensense MPU6509
	  motion tracking devices over SPI.
	  This driver can be built as a module. The module will be called
	  inv-mpu6509-spi.

config INV_MPU6509_TRIGGER
	bool "MPU6509 use sysfs trigger"
	default n
	help
	  Say Y here if you want to use sysfs trigger for MPU6509
	  When in doubt, say "N".
```

## SCA200X_SDK_V1.3.8_GLIBC/01.software/board/SCA200X_SDK_V1.3.8_GLIBC/osdrv/opensource/kernel/linux-linaro-stable-lsk-v4.9-17.07/drivers/media/platform/sc_cam/Kconfig
```kconfig
config VIDEO_SMARTCHIP_CAM
        tristate "SmartChip camera support"
        depends on ARCH_SMARTCHIP
        #select VIDEOBUF2_DMA_CONTIG
	#select VIDEOBUF2_VMALLOC
	select VIDEOBUF2_CORE
	#select SMARTCHIP_CAM_RPC
	#select SMARTCHIP_CAM_RPC_API
	#select SMARTCHIP_CAM_RPC_LOG
	#select SMARTCHIP_CAM_RPC_DEBUG
        ---help---
          This is a v4l2 driver for SmartChip Smartx camera

config SMARTCHIP_CAM_RPC
	bool "SmartChip camera RPC"
#	#depends on VIDEO_SMARTCHIP_CAM
#	---help---
#	  The RPC for SmartChip camera, must select
#
config SMARTCHIP_CAM_RPC_API
	bool "SmartChip camera RPC API"
#	#depends on SMARTCHIP_CAM_RPC
#	---help---
#	  SmartChip RPC API support for cameras
#
config SMARTCHIP_CAM_RPC_LOG
	bool "SmartChip camera RPC log"
#	depends on SMARTCHIP_CAM_RPC
#	---help---
#	  SmartChip logs support for camera
#
config SMARTCHIP_CAM_RPC_DEBUG
	bool "SmartChip camera RPC debugfs support"
#	#depends on SMARTCHIP_CAM_RPC
#	---help---
#	  SmartChip RPC debugfs support for camera
```

## SCA200X_SDK_V1.3.8_GLIBC/01.software/board/SCA200X_SDK_V1.3.8_GLIBC/osdrv/opensource/kernel/linux-linaro-stable-lsk-v4.9-17.07/drivers/net/can/smartchip/Kconfig
```kconfig
config CAN_SCA200V100
	tristate "SmartChip SCA200V100 can devices"
	depends on ARCH_SMARTCHIP || ARM || ARM64
	---help---
	  Say Y here if you want to use CAN controller found on SmartChip sca200v100
	  SoCs.
```

## SCA200X_SDK_V1.3.8_GLIBC/01.software/board/SCA200X_SDK_V1.3.8_GLIBC/osdrv/opensource/kernel/linux-linaro-stable-lsk-v4.9-17.07/drivers/net/ethernet/smartchip/Kconfig
```kconfig
config SMARTX_ETH
	tristate "Smartx Ethernet support"
	select CRC32
	select MII
	select PHYLIB
	default y

config SMARTX_ETH_BASIC_FEATURES
	bool "Disable Gigabit Ethernet Features"
	depends on SMARTX_ETH
	---help---
	  Do not advertise 1000BT capabilities during auto negotiation process,
	  even if supported by ethernet core.
```

## SCA200X_SDK_V1.3.8_GLIBC/01.software/board/SCA200X_SDK_V1.3.8_GLIBC/osdrv/opensource/kernel/linux-linaro-stable-lsk-v4.9-17.07/drivers/pci/dwc/Kconfig
```kconfig
menu "DesignWare PCI Core Support"

config PCIE_DW
    bool

config PCIE_DW_HOST
    bool
    depends on PCI
    depends on PCI_MSI_IRQ_DOMAIN
    select PCIE_DW

config PCIE_DW_EP
    bool
    depends on PCI_ENDPOINT
    select PCIE_DW

config PCIE_DW_PLAT
	bool "Platform bus based DesignWare PCIe Controller"
	depends on PCI
	depends on PCI_MSI_IRQ_DOMAIN
	select PCIE_DW_HOST
	---help---
	 This selects the DesignWare PCIe controller support. Select this if
	 you have a PCIe controller on Platform bus.

	 If you have a controller with this interface, say Y or M here.

	 If unsure, say N.

config PCI_SCA200V100
    bool "AR PCIe controller"
    depends on (PCI && PCI_MSI_IRQ_DOMAIN) || PCI_ENDPOINT
    help
        SmartChip DUAL role PCIe controller. In order to enable host-specific features PCI_SCA200V100_HOST must be selected and in order to enable device-specific features PCI_SCA200V100_EP must be selected. This uses the Designware core.

if PCI_SCA200V100

config PCI_SCA200V100_HOST
    bool "PCI SCA200V100 Host Mode"
    depends on PCI
    depends on PCI_MSI_IRQ_DOMAIN
    select PCIE_DW_HOST
    default y
    help
        Enables support for the PCIe controller in the SCA200V100 SoC to work in host mode.

config PCI_SCA200V100_EP
    bool "PCI SCA200V100 Endpoint Mode"
    depends on PCI_ENDPOINT
    select PCIE_DW_EP
    help
        Enables support for the PCIe controller in the SCA200V100 SoC to work in endpoint mode.

endif

endmenu
```

## SCA200X_SDK_V1.3.8_GLIBC/01.software/board/SCA200X_SDK_V1.3.8_GLIBC/osdrv/opensource/kernel/linux-linaro-stable-lsk-v4.9-17.07/drivers/sc_dvfs/Kconfig
```kconfig
config SMARTCHIP_DVFS
	tristate "DVFS for smartchip"
	help
	  Choose this option if you wish to use dvfs on smartchip Platform.
```

## SCA200X_SDK_V1.3.8_GLIBC/01.software/board/SCA200X_SDK_V1.3.8_GLIBC/osdrv/opensource/kernel/linux-linaro-stable-lsk-v4.9-17.07/drivers/sc_icc/Kconfig
```kconfig
config SMARTCHIP_ICC
	tristate "Icc for smartchip"
	help
	  Choose this option if you wish to use icc on smartchip Platform.
```

## SCA200X_SDK_V1.3.8_GLIBC/01.software/board/SCA200X_SDK_V1.3.8_GLIBC/osdrv/opensource/kernel/linux-linaro-stable-lsk-v4.9-17.07/drivers/usb/cdns_drd_tc/Kconfig
```kconfig
config USB_CDNS_DRD_TC
	tristate "Cadence USB DRD Core Support"
	depends on USB && HAS_DMA
	select USB_XHCI_PLATFORM if USB_SUPPORT && USB_XHCI_HCD
	help
	  Say Y or M here if your system has a Dual Role SuperSpeed
	  USB controller based on the Cadence USB3 IP Core.

	  If you choose to build this driver is a dynamically linked
	  module, the module will be called cdns_drd_tc.ko.

if USB_CDNS_DRD_TC

config USB_CDNS_MISC
	bool "Additional miscellaneous device for ioctl"
	depends on (USB=y || USB=USB_CDNS_DRD_TC)
	help
	  Select this if you want to send commands to driver
	  using I/O control.

config USB_CDNS_DRD_PCI
  tristate "PCIe-based Platform for DRD"
  depends on PCI && USB_CDNS_DRD_TC
  default USB_CDNS_DRD_TC
  help
    If you're using the Cadence DRD IP with a PCIe, please say
    'Y' or 'M' here.

endif

config USB_CDNS_GADGET
  tristate "Cadence device controller"
  depends on USB_GADGET
  help
    Say 'Y' or 'M' here to enable device controller functionality 
    of the Cadence driver.

if USB_CDNS_GADGET

config USB_CDNS_HG_PCI
  tristate "PCIe-based Platform for host and gadegt"
  depends on PCI && USB_XHCI_HCD && USB_CDNS_GADGET
  default USB_CDNS_GADGET
  help
    If you're using the Cadence Gadget IP with a PCIe, please say
    'Y' or 'M' here.

endif

comment "Platform Glue Driver Support"
```

## SCA200X_SDK_V1.3.8_GLIBC/01.software/board/SCA200X_SDK_V1.3.8_GLIBC/osdrv/opensource/kernel/linux-linaro-stable-lsk-v4.9-17.07/drivers/usb/typec/altmodes/Kconfig
```kconfig
menu "USB Type-C Alternate Mode drivers"

config TYPEC_DP_ALTMODE
	tristate "DisplayPort Alternate Mode driver"
	help
	  DisplayPort USB Type-C Alternate Mode allows DisplayPort
	  displays and adapters to be attached to the USB Type-C
	  connectors on the system.

	  To compile this driver as a module, choose M here: the
	  module will be called typec_displayport.

config TYPEC_DP_CORE
	tristate "Smartx USB TYPE C DP PHY Driver"
	depends on USB
	depends on TYPEC_TCPM
	help
	  Enable this to support Smartx USB phy. This driver provides
	  USB 3.0 TYPE C PHY that is part of the Smartx SOC.

endmenu
```

## SCA200X_SDK_V1.3.8_GLIBC/01.software/board/SCA200X_SDK_V1.3.8_GLIBC/osdrv/opensource/uboot/u-boot-v2020.10/arch/arm/mach-smartchip/Kconfig
```kconfig
if ARCH_SMARTCHIP

config SMARTCHIP_SCA200V100
	bool "Support SmartChip SCA200V100"
	select ARM64
	select SUPPORT_SPL
	imply SPL_SEPARATE_BSS
	select SPL_SERIAL_SUPPORT if SPL
	select DEBUG_UART_BOARD_INIT
	help
	  The SmartChip SCA200V100 is a ARM-based SoC with a quad-core Cortex-A53
	  including NEON several DDR4 options
	  and video codec support. Peripherals include Gigabit Ethernet,
	  USB2 host and OTG, SDIO, I2S, UART, SPI, I2C and PWMs.

config SMARTCHIP_SCA200V200
	bool "Support SmartChip SCA200V200"
	select ARM64
	select SUPPORT_SPL
	imply SPL_SEPARATE_BSS
	select SPL_SERIAL_SUPPORT if SPL
	select DEBUG_UART_BOARD_INIT
	help
	  The SmartChip SCA200V200 is a ARM-based SoC with a dual-core Cortex-A53
	  including NEON several DDR4 options
	  and video codec support. Peripherals include Gigabit Ethernet,
	  USB2 host and OTG, SDIO, I2S, UART, SPI, I2C and PWMs.

config SYS_VENDOR
	default "smartchip"

source arch/arm/mach-smartchip/sca200v100/Kconfig
source arch/arm/mach-smartchip/sca200v200/Kconfig

endif
```

## SCA200X_SDK_V1.3.8_GLIBC/01.software/board/SCA200X_SDK_V1.3.8_GLIBC/osdrv/opensource/uboot/u-boot-v2020.10/arch/arm/mach-smartchip/sca200v100/Kconfig
```kconfig
if SMARTCHIP_SCA200V100

config SYS_SOC
	string
	default "sca200v100"

config SYS_MALLOC_F_LEN
	hex
	default 0x400

config DEBUG_UART_CHANNEL
	int "Mux channel to use for debug UART2/UART3"
	depends on DEBUG_UART_BOARD_INIT
	default 0
	help
	  UART2 and UART3 can use two different set of pins to route the output.
	  For using the UART for early debugging the route to use needs
	  to be declared (0 or 1).

source "board/smartchip/evb_sca200v100/Kconfig"

endif
```

## SCA200X_SDK_V1.3.8_GLIBC/01.software/board/SCA200X_SDK_V1.3.8_GLIBC/osdrv/opensource/uboot/u-boot-v2020.10/board/smartchip/evb_sca200v100/Kconfig
```kconfig
choice
	prompt "sca200v100 Board"
	default SCA200V100_BD1_EVB

config SCA200V100_BD1_EVB
	bool "sca200v100 board1"
	help
	  demo board

config SCA200V100_BD2_DEV
	bool "sca200v100 board2"
	help
	  develop demo board

config SCA200V100_BD3_DEV
	bool "sca200v100 board3"
	help
	  face demo board

config SCA200V100_BD4_DEV
	bool "sca200v100 board4"
	help
	  ipc demo board

config SCA200V102_BD1_FAST
	bool "sca200v102 board1 fast"
	help
	  sca200v102 demo board

endchoice #"sca200v100 Board"

config SCA200VX_BL1_IMG
	string "bl1 image"
	default "bl1_sdram.img"
	help
	  boot loader 1 image

config SYS_CONFIG_NAME
	default "sca200v100_evb"

config SYS_BOARD
	default "evb_sca200v100"

config GMAC_TX_DELAY
	int "GMAC Transmit Clock Delay Chain"
	default 0
	help
	  Set the GMAC Transmit Clock Delay Chain value.
```

## SCA200X_SDK_V1.3.8_GLIBC/01.software/board/SCA200X_SDK_V1.3.8_GLIBC/osdrv/opensource/uboot/u-boot-v2020.10/board/smartchip/evb_sca200v200/Kconfig
```kconfig
choice
	prompt "sca200v200 Board"
	default SCA200V200_BD1_EVB

config SCA200V200_BD1_EVB
	bool "sca200v200 board1"
	help
	  demo board

endchoice #"sca200v200 Board"

config SCA200VX_BL1_IMG
	string "bl1 image"
	default "bl1_sdram.img"
	help
	  boot loader 1 image

config SYS_CONFIG_NAME
	default "sca200v200_evb"

config SYS_BOARD
	default "evb_sca200v200"

config GMAC_TX_DELAY
	int "GMAC Transmit Clock Delay Chain"
	default 0
	help
	  Set the GMAC Transmit Clock Delay Chain value.
```

## SCA200X_SDK_V1.3.8_GLIBC/01.software/board/SCA200X_SDK_V1.3.8_GLIBC/osdrv/opensource/uboot/u-boot-v2020.10/drivers/gicv2/Kconfig
```kconfig
#menu "GICV2 Support"

config GICV2_SC
	bool "smartchip gicv2 driver"
	default y
	help
		gicv2 driver

#endmenu # menu "GICV2 Support"
```

## SCA200X_SDK_V1.3.8_GLIBC/01.software/board/SCA200X_SDK_V1.3.8_GLIBC/osdrv/opensource/uboot/u-boot-v2020.10/drivers/vo/Kconfig
```kconfig
#menu "VO Support"

config VO
	bool "smartchip vo driver"
	default y
	help
		vo driver

#endmenu # menu "VO Support"
```

## SCA200X_SDK_V1.3.8_GLIBC/01.software/board/SCA200X_SDK_V1.3.8_GLIBC/osdrv/tools/pc/fwup/firmware.its
```
/*
 * Automatic software update for Firmware
 * Make sure the flashing addresses ('load' prop) is correct for your board!
 */

/dts-v1/;

/ {
	description = "smartchip firmware";
	#address-cells = <1>;

	images {
		update-1 {
			description = "boot";
			data = /incbin/("images/boot.img");
			compression = "none";
			type = "standalone";
			arch = "arm64";

			load = <0x00000000>;
			entry = <0x1>;
			hash-1 {
				algo = "md5";
			};
		};
		update-2 {
			description = "kernel";
			data = /incbin/("images/kernel.img");
			compression = "none";
			type = "kernel";
			arch = "arm64";
			os = "linux";

			load = <0x800>;
			entry = <0x0>;
			hash-1 {
				algo = "md5";
			};
		};
		update-3 {
			description = "kernel.dtb";
			data = /incbin/("images/kernel.dtb");
			compression = "none";
			type = "standalone";
			arch = "arm64";
			os = "linux";

			load = <0x4800>;
			entry = <0x0>;
			hash-1 {
				algo = "md5";
			};
		};
		update-4 {
			description = "rootfs";
			data = /incbin/("images/linux.ext4.sparse.img");
			compression = "none";
			type = "ramdisk";
			arch = "arm64";

			load = <0x4c00>;
			entry = <0x0>;
			hash-1 {
				algo = "md5";
			};
		};
	};
};
```
