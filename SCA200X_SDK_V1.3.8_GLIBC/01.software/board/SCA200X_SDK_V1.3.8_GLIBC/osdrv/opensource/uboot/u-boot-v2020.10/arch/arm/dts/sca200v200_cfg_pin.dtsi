#include <dt-bindings/pinctrl/pinctrl-sca200v200.h>

&soc {
	pinctrl {
		u-boot,dm-pre-reloc;
		compatible = "smartchip,sca200v200-pinctrl";
		reg = <0x0A10A000 0x00000BC>;	// pb_sw_reg_base
		pinctrl-cfgs = <
			//eth
			(PIN0   | FUNCTION_MODE1 | DRIVING_SELECTOR_2 | PULL_DOWN | SCHMITT_TRIGGER_DISABLE | SLEW_RATE_DISABLE)
			(PIN1   | FUNCTION_MODE1 | DRIVING_SELECTOR_2 | PULL_DOWN | SCHMITT_TRIGGER_DISABLE | SLEW_RATE_DISABLE)
			(PIN2   | FUNCTION_MODE1 | DRIVING_SELECTOR_2 | PULL_DOWN | SCHMITT_TRIGGER_DISABLE | SLEW_RATE_DISABLE)
			(PIN3   | FUNCTION_MODE1 | DRIVING_SELECTOR_2 | PULL_DOWN | SCHMITT_TRIGGER_DISABLE | SLEW_RATE_DISABLE)
			(PIN4   | FUNCTION_MODE1 | DRIVING_SELECTOR_2 | PULL_DOWN | SCHMITT_TRIGGER_DISABLE | SLEW_RATE_DISABLE)
			(PIN5   | FUNCTION_MODE1 | DRIVING_SELECTOR_2 | PULL_DOWN | SCHMITT_TRIGGER_DISABLE | SLEW_RATE_DISABLE)
			(PIN6   | FUNCTION_MODE1 | DRIVING_SELECTOR_2 | PULL_DOWN | SCHMITT_TRIGGER_DISABLE | SLEW_RATE_DISABLE)
			(PIN7   | FUNCTION_MODE1 | DRIVING_SELECTOR_2 | PULL_DOWN | SCHMITT_TRIGGER_DISABLE | SLEW_RATE_DISABLE)
			(PIN8   | FUNCTION_MODE1 | DRIVING_SELECTOR_2 | PULL_DOWN | SCHMITT_TRIGGER_DISABLE | SLEW_RATE_DISABLE)
			(PIN9   | FUNCTION_MODE1 | DRIVING_SELECTOR_2 | PULL_DOWN | SCHMITT_TRIGGER_DISABLE | SLEW_RATE_DISABLE)
			(PIN10  | FUNCTION_MODE1 | DRIVING_SELECTOR_2 | PULL_DOWN | SCHMITT_TRIGGER_DISABLE | SLEW_RATE_DISABLE)
			//wdt0
			//(PIN10  | FUNCTION_MODE3 | DRIVING_SELECTOR_2 | PULL_DOWN | SCHMITT_TRIGGER_DISABLE | SLEW_RATE_DISABLE)
			//i2c0
			//(PIN12  | FUNCTION_MODE1 | DRIVING_SELECTOR_2 | PULL_UP   | SCHMITT_TRIGGER_DISABLE | SLEW_RATE_DISABLE)
			//(PIN13  | FUNCTION_MODE1 | DRIVING_SELECTOR_2 | PULL_UP   | SCHMITT_TRIGGER_DISABLE | SLEW_RATE_DISABLE)
            //i2c 0
            (PIN35  | FUNCTION_MODE1 | DRIVING_SELECTOR_2 | PULL_UP   | SCHMITT_TRIGGER_DISABLE | SLEW_RATE_DISABLE)
			(PIN36  | FUNCTION_MODE1 | DRIVING_SELECTOR_2 | PULL_UP   | SCHMITT_TRIGGER_DISABLE | SLEW_RATE_DISABLE)
			//vbus power
			(PIN102  | FUNCTION_MODE0 | DRIVING_SELECTOR_2 | PULL_UP | SCHMITT_TRIGGER_DISABLE | SLEW_RATE_DISABLE)
			// sd
			(PIN11  | FUNCTION_MODE1 | DRIVING_SELECTOR_2 | PULL_UP | SCHMITT_TRIGGER_DISABLE | SLEW_RATE_DISABLE)
			(PIN12  | FUNCTION_MODE0 | DRIVING_SELECTOR_2 | PULL_UP | SCHMITT_TRIGGER_DISABLE | SLEW_RATE_DISABLE)
			(PIN13  | FUNCTION_MODE1 | DRIVING_SELECTOR_2 | PULL_UP | SCHMITT_TRIGGER_DISABLE | SLEW_RATE_DISABLE)
			(PIN14  | FUNCTION_MODE0 | DRIVING_SELECTOR_2 | PULL_UP | SCHMITT_TRIGGER_DISABLE | SLEW_RATE_DISABLE)
			(PIN71  | FUNCTION_MODE1 | DRIVING_SELECTOR_2 | PULL_UP | SCHMITT_TRIGGER_DISABLE | SLEW_RATE_DISABLE)
			(PIN72  | FUNCTION_MODE1 | DRIVING_SELECTOR_2 | PULL_UP | SCHMITT_TRIGGER_DISABLE | SLEW_RATE_DISABLE)
			(PIN73  | FUNCTION_MODE1 | DRIVING_SELECTOR_2 | PULL_UP | SCHMITT_TRIGGER_DISABLE | SLEW_RATE_DISABLE)
			(PIN74  | FUNCTION_MODE1 | DRIVING_SELECTOR_2 | PULL_UP | SCHMITT_TRIGGER_DISABLE | SLEW_RATE_DISABLE)
			(PIN75  | FUNCTION_MODE1 | DRIVING_SELECTOR_2 | PULL_UP | SCHMITT_TRIGGER_DISABLE | SLEW_RATE_DISABLE)
			(PIN76  | FUNCTION_MODE1 | DRIVING_SELECTOR_2 | NO_PULL | SCHMITT_TRIGGER_DISABLE | SLEW_RATE_DISABLE)
			(PIN77  | FUNCTION_MODE1 | DRIVING_SELECTOR_2 | PULL_UP | SCHMITT_TRIGGER_DISABLE | SLEW_RATE_DISABLE)
			(PIN78  | FUNCTION_MODE1 | DRIVING_SELECTOR_2 | PULL_UP | SCHMITT_TRIGGER_DISABLE | SLEW_RATE_DISABLE)
			(PIN79  | FUNCTION_MODE1 | DRIVING_SELECTOR_2 | PULL_UP | SCHMITT_TRIGGER_DISABLE | SLEW_RATE_DISABLE)
			(PIN80  | FUNCTION_MODE1 | DRIVING_SELECTOR_2 | PULL_UP | SCHMITT_TRIGGER_DISABLE | SLEW_RATE_DISABLE)
			(PIN81  | FUNCTION_MODE1 | DRIVING_SELECTOR_2 | PULL_UP | SCHMITT_TRIGGER_DISABLE | SLEW_RATE_DISABLE)
			(PIN82  | FUNCTION_MODE1 | DRIVING_SELECTOR_2 | NO_PULL | SCHMITT_TRIGGER_DISABLE | SLEW_RATE_DISABLE)
			//emmc
			(PIN70  | FUNCTION_MODE0 | DRIVING_SELECTOR_2 | PULL_UP | SCHMITT_TRIGGER_DISABLE | SLEW_RATE_DISABLE)
			(PIN83  | FUNCTION_MODE1 | DRIVING_SELECTOR_2 | PULL_UP | SCHMITT_TRIGGER_DISABLE | SLEW_RATE_DISABLE)
			(PIN84  | FUNCTION_MODE1 | DRIVING_SELECTOR_2 | PULL_UP | SCHMITT_TRIGGER_DISABLE | SLEW_RATE_DISABLE)
			(PIN85  | FUNCTION_MODE1 | DRIVING_SELECTOR_2 | PULL_UP | SCHMITT_TRIGGER_DISABLE | SLEW_RATE_DISABLE)
			(PIN86  | FUNCTION_MODE1 | DRIVING_SELECTOR_2 | PULL_UP | SCHMITT_TRIGGER_DISABLE | SLEW_RATE_DISABLE)
			(PIN87  | FUNCTION_MODE1 | DRIVING_SELECTOR_2 | PULL_UP | SCHMITT_TRIGGER_DISABLE | SLEW_RATE_DISABLE)
			(PIN88  | FUNCTION_MODE1 | DRIVING_SELECTOR_2 | PULL_UP | SCHMITT_TRIGGER_DISABLE | SLEW_RATE_DISABLE)
			(PIN89  | FUNCTION_MODE1 | DRIVING_SELECTOR_2 | PULL_UP | SCHMITT_TRIGGER_DISABLE | SLEW_RATE_DISABLE)
			(PIN90  | FUNCTION_MODE1 | DRIVING_SELECTOR_2 | PULL_UP | SCHMITT_TRIGGER_DISABLE | SLEW_RATE_DISABLE)
			(PIN91  | FUNCTION_MODE1 | DRIVING_SELECTOR_2 | NO_PULL | SCHMITT_TRIGGER_DISABLE | SLEW_RATE_DISABLE)
			(PIN92  | FUNCTION_MODE1 | DRIVING_SELECTOR_2 | PULL_UP | SCHMITT_TRIGGER_DISABLE | SLEW_RATE_DISABLE)
			(PIN93  | FUNCTION_MODE1 | DRIVING_SELECTOR_2 | NO_PULL | SCHMITT_TRIGGER_DISABLE | SLEW_RATE_DISABLE)
            //97 109 for sensor0 , 104 108 for sensor2, pwn and reset
            (PIN97 | FUNCTION_MODE0 | DRIVING_SELECTOR_2 | PULL_UP | SCHMITT_TRIGGER_DISABLE | SLEW_RATE_DISABLE)
			(PIN104 | FUNCTION_MODE0 | DRIVING_SELECTOR_2 | PULL_UP | SCHMITT_TRIGGER_DISABLE | SLEW_RATE_DISABLE)
			(PIN106 | FUNCTION_MODE0 | DRIVING_SELECTOR_2 | PULL_UP | SCHMITT_TRIGGER_DISABLE | SLEW_RATE_DISABLE)
			(PIN108 | FUNCTION_MODE0 | DRIVING_SELECTOR_2 | PULL_UP | SCHMITT_TRIGGER_DISABLE | SLEW_RATE_DISABLE)
			(PIN109 | FUNCTION_MODE0 | DRIVING_SELECTOR_2 | PULL_UP | SCHMITT_TRIGGER_DISABLE | SLEW_RATE_DISABLE)
		    //i2c 1
            (PIN37 | FUNCTION_MODE1 | DRIVING_SELECTOR_2 | PULL_UP | SCHMITT_TRIGGER_DISABLE | SLEW_RATE_DISABLE)
			(PIN38 | FUNCTION_MODE1 | DRIVING_SELECTOR_2 | PULL_UP | SCHMITT_TRIGGER_DISABLE | SLEW_RATE_DISABLE)
            //i2c 2
			(PIN97 | FUNCTION_MODE1 | DRIVING_SELECTOR_2 | PULL_UP | SCHMITT_TRIGGER_DISABLE | SLEW_RATE_DISABLE)
	        (PIN98 | FUNCTION_MODE1 | DRIVING_SELECTOR_2 | PULL_UP | SCHMITT_TRIGGER_DISABLE | SLEW_RATE_DISABLE)
    		(PIN99 | FUNCTION_MODE1 | DRIVING_SELECTOR_2 | PULL_UP | SCHMITT_TRIGGER_DISABLE | SLEW_RATE_DISABLE)
            //i2c3
           (PIN100 | FUNCTION_MODE1 | DRIVING_SELECTOR_2 | PULL_UP |  SCHMITT_TRIGGER_DISABLE | SLEW_RATE_DISABLE)  //  I2C3 SDA
    	    (PIN101 | FUNCTION_MODE1 | DRIVING_SELECTOR_2 | PULL_UP |  SCHMITT_TRIGGER_DISABLE | SLEW_RATE_DISABLE)  //  I2C3 SCL


			(PIN41 | FUNCTION_MODE4 | DRIVING_SELECTOR_3 | PULL_DOWN |SCHMITT_TRIGGER_DISABLE | SLEW_RATE_DISABLE)  //  SENSOR2 MCLK

			(PIN45 | FUNCTION_MODE1 | DRIVING_SELECTOR_3 | PULL_DOWN |SCHMITT_TRIGGER_DISABLE | SLEW_RATE_DISABLE)  //  DVPC-OUT PDATA0
			(PIN46 | FUNCTION_MODE1 | DRIVING_SELECTOR_3 | PULL_DOWN |SCHMITT_TRIGGER_DISABLE | SLEW_RATE_DISABLE)  //  DVPC-OUT PDATA1
			(PIN47 | FUNCTION_MODE1 | DRIVING_SELECTOR_3 | PULL_DOWN |SCHMITT_TRIGGER_DISABLE | SLEW_RATE_DISABLE)  //  DVPC-OUT PDATA
			(PIN48 | FUNCTION_MODE1 | DRIVING_SELECTOR_3 | PULL_DOWN |SCHMITT_TRIGGER_DISABLE | SLEW_RATE_DISABLE)  //  DVPC-OUT PDATA0
			(PIN49 | FUNCTION_MODE1 | DRIVING_SELECTOR_3 | PULL_DOWN |SCHMITT_TRIGGER_DISABLE | SLEW_RATE_DISABLE)  //  DVPC-OUT PDATA0
			(PIN50 | FUNCTION_MODE1 | DRIVING_SELECTOR_3 | PULL_DOWN |SCHMITT_TRIGGER_DISABLE | SLEW_RATE_DISABLE)  //  DVPC-OUT PDATA0
			(PIN51 | FUNCTION_MODE1 | DRIVING_SELECTOR_3 | PULL_DOWN |SCHMITT_TRIGGER_DISABLE | SLEW_RATE_DISABLE)  //  DVPC-OUT PDATA0
			(PIN52 | FUNCTION_MODE1 | DRIVING_SELECTOR_3 | PULL_DOWN |SCHMITT_TRIGGER_DISABLE | SLEW_RATE_DISABLE)  //  DVPC-OUT PDATA0
			(PIN53 | FUNCTION_MODE1 | DRIVING_SELECTOR_3 | PULL_DOWN |SCHMITT_TRIGGER_DISABLE | SLEW_RATE_DISABLE)  //  DVPC-OUT PDATA0
			(PIN54 | FUNCTION_MODE1 | DRIVING_SELECTOR_3 | PULL_DOWN |SCHMITT_TRIGGER_DISABLE | SLEW_RATE_DISABLE)  //  DVPC-OUT PDATA0
			(PIN55 | FUNCTION_MODE1 | DRIVING_SELECTOR_3 | PULL_DOWN |SCHMITT_TRIGGER_DISABLE | SLEW_RATE_DISABLE)  //  DVPC-OUT PDATA0
			(PIN56 | FUNCTION_MODE1 | DRIVING_SELECTOR_3 | PULL_DOWN |SCHMITT_TRIGGER_DISABLE | SLEW_RATE_DISABLE)  //  DVPC-OUT PDATA0
			(PIN57 | FUNCTION_MODE1 | DRIVING_SELECTOR_3 | PULL_DOWN |SCHMITT_TRIGGER_DISABLE | SLEW_RATE_DISABLE)  //  DVPC-OUT PDATA0
			(PIN58 | FUNCTION_MODE1 | DRIVING_SELECTOR_3 | PULL_DOWN |SCHMITT_TRIGGER_DISABLE | SLEW_RATE_DISABLE)  //  DVPC-OUT PDATA0
			(PIN59 | FUNCTION_MODE1 | DRIVING_SELECTOR_3 | PULL_DOWN |SCHMITT_TRIGGER_DISABLE | SLEW_RATE_DISABLE)  //  DVPC-OUT PDATA0
			(PIN60 | FUNCTION_MODE1 | DRIVING_SELECTOR_3 | PULL_DOWN |SCHMITT_TRIGGER_DISABLE | SLEW_RATE_DISABLE)  //  DVPC-OUT PDATA0
			(PIN61 | FUNCTION_MODE1 | DRIVING_SELECTOR_3 | PULL_DOWN |SCHMITT_TRIGGER_DISABLE | SLEW_RATE_DISABLE)  //  DVPC-OUT PDATA0
			(PIN62 | FUNCTION_MODE1 | DRIVING_SELECTOR_3 | PULL_DOWN |SCHMITT_TRIGGER_DISABLE | SLEW_RATE_DISABLE)  //  DVPC-OUT PDATA0
			(PIN63 | FUNCTION_MODE1 | DRIVING_SELECTOR_3 | PULL_DOWN |SCHMITT_TRIGGER_DISABLE | SLEW_RATE_DISABLE)  //  DVPC-OUT PDATA0
			(PIN64 | FUNCTION_MODE1 | DRIVING_SELECTOR_3 | PULL_DOWN |SCHMITT_TRIGGER_DISABLE | SLEW_RATE_DISABLE)  //  DVPC-OUT PDATA0


			(PIN107 | FUNCTION_MODE0 | DRIVING_SELECTOR_2 | PULL_DOWN | SCHMITT_TRIGGER_DISABLE | SLEW_RATE_DISABLE)  // PIN_1F17

			// dvp A
			(PIN23 | FUNCTION_MODE1 | DRIVING_SELECTOR_2 | PULL_DOWN | SCHMITT_TRIGGER_DISABLE | SLEW_RATE_DISABLE)
			(PIN24 | FUNCTION_MODE1 | DRIVING_SELECTOR_2 | PULL_DOWN | SCHMITT_TRIGGER_DISABLE | SLEW_RATE_DISABLE)
			(PIN25 | FUNCTION_MODE1 | DRIVING_SELECTOR_2 | PULL_DOWN | SCHMITT_TRIGGER_DISABLE | SLEW_RATE_DISABLE)
			(PIN26 | FUNCTION_MODE1 | DRIVING_SELECTOR_2 | PULL_DOWN | SCHMITT_TRIGGER_DISABLE | SLEW_RATE_DISABLE)
			(PIN27 | FUNCTION_MODE1 | DRIVING_SELECTOR_2 | PULL_DOWN | SCHMITT_TRIGGER_DISABLE | SLEW_RATE_DISABLE)
			(PIN28 | FUNCTION_MODE1 | DRIVING_SELECTOR_2 | PULL_DOWN | SCHMITT_TRIGGER_DISABLE | SLEW_RATE_DISABLE)
			(PIN29 | FUNCTION_MODE1 | DRIVING_SELECTOR_2 | PULL_DOWN | SCHMITT_TRIGGER_DISABLE | SLEW_RATE_DISABLE)
			(PIN30 | FUNCTION_MODE1 | DRIVING_SELECTOR_2 | PULL_DOWN | SCHMITT_TRIGGER_DISABLE | SLEW_RATE_DISABLE)
			(PIN31 | FUNCTION_MODE1 | DRIVING_SELECTOR_2 | PULL_DOWN | SCHMITT_TRIGGER_DISABLE | SLEW_RATE_DISABLE)
			(PIN32 | FUNCTION_MODE1 | DRIVING_SELECTOR_2 | PULL_DOWN | SCHMITT_TRIGGER_DISABLE | SLEW_RATE_DISABLE)
			(PIN33 | FUNCTION_MODE1 | DRIVING_SELECTOR_2 | PULL_DOWN | SCHMITT_TRIGGER_DISABLE | SLEW_RATE_DISABLE)
			(PIN34 | FUNCTION_MODE1 | DRIVING_SELECTOR_2 | PULL_DOWN | SCHMITT_TRIGGER_DISABLE | SLEW_RATE_DISABLE)

			(PIN94 | FUNCTION_MODE0 | DRIVING_SELECTOR_2 | PULL_DOWN | SCHMITT_TRIGGER_DISABLE | SLEW_RATE_DISABLE)
			(PIN17 | FUNCTION_MODE0 | DRIVING_SELECTOR_2 | PULL_DOWN | SCHMITT_TRIGGER_DISABLE | SLEW_RATE_DISABLE)
			(PIN18 | FUNCTION_MODE0 | DRIVING_SELECTOR_2 | PULL_DOWN | SCHMITT_TRIGGER_DISABLE | SLEW_RATE_DISABLE)
			(PIN19 | FUNCTION_MODE0 | DRIVING_SELECTOR_2 | PULL_DOWN | SCHMITT_TRIGGER_DISABLE | SLEW_RATE_DISABLE)
			(PIN20 | FUNCTION_MODE0 | DRIVING_SELECTOR_2 | PULL_DOWN | SCHMITT_TRIGGER_DISABLE | SLEW_RATE_DISABLE)
			// audio out L & R
			(PIN13 | FUNCTION_MODE0 | DRIVING_SELECTOR_2 | PULL_UP | SCHMITT_TRIGGER_DISABLE | SLEW_RATE_DISABLE)
			(PIN22 | FUNCTION_MODE0 | DRIVING_SELECTOR_2 | PULL_UP | SCHMITT_TRIGGER_DISABLE | SLEW_RATE_DISABLE)
			// i2s1 master
			(PIN65 | FUNCTION_MODE3 | DRIVING_SELECTOR_2 | PULL_UP | SCHMITT_TRIGGER_DISABLE | SLEW_RATE_DISABLE)
			(PIN66 | FUNCTION_MODE3 | DRIVING_SELECTOR_2 | PULL_UP | SCHMITT_TRIGGER_DISABLE | SLEW_RATE_DISABLE)
			(PIN67 | FUNCTION_MODE3 | DRIVING_SELECTOR_2 | PULL_UP | SCHMITT_TRIGGER_DISABLE | SLEW_RATE_DISABLE)
			(PIN68 | FUNCTION_MODE3 | DRIVING_SELECTOR_2 | PULL_UP | SCHMITT_TRIGGER_DISABLE | SLEW_RATE_DISABLE)
		>;
		pb-msc-cfgs = <
			(PB_MSC_BIT0  | PB_MSC_REG_PIN_V33)  // PB000_PB022, GPIOA
			(PB_MSC_BIT1  | PB_MSC_REG_PIN_V18)  // PB023_PB044, GPIOB
			(PB_MSC_BIT2  | PB_MSC_REG_PIN_V18)  // PB045_PB070, GPIOC
			(PB_MSC_BIT3  | PB_MSC_REG_PIN_V33)  // PB071_PB076, GPIOD
			(PB_MSC_BIT4  | PB_MSC_REG_PIN_V33)  // PB077_PB082, GPIOE
			(PB_MSC_BIT5  | PB_MSC_REG_PIN_V33)  // PB083_PB093, GPIOF
			(PB_MSC_BIT6  | PB_MSC_REG_PIN_V18)  // PB094_PB109, GPIOG
		>;
	};
};
