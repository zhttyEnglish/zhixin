#include <dt-bindings/clock/sca200v200-cgu.h>

&soc {
	cgu: cgu@0a104000{
		u-boot,dm-pre-reloc;
		compatible = "smartchip,sca200v200-cgu";
		reg = <0x0a100000 0x00002000	// a53
		       0x0a102000 0x00002000	// rgu
		       0x0a104000 0x00002000	// cgu
		       0x0a106000 0x00002000	// sys_ctrl
		       0x0a108000 0x00002000>;	// abb

		power-default-config = < (PWR_CORE1	| PWR_ON)
					 (PWR_VISION	| PWR_ON)
					 (PWR_NPU_CORE	| PWR_OFF)
//					 (PWR_NPU_TOP	| PWR_ON)
					 (PWR_DLA	| PWR_ON)
					 (PWR_VENC	| PWR_ON) >;

		abb-freqs = <
				148500000		// abb_pixel_freq	148.5MHz
			     74250000		// abb_pixel1_freq	74.25MHz
			     148500000		// abb_pixel2_freq	148.5MHz
			     297000000		// abb_pixel3_freq	297MHz
			     600000000		// abb_pixel4_freq	600MHz
			     903168000>; 	// abb_audio_freq	903168KHz
		clk-default-config = <
					/* CLOCK ID ------------| CLOCK GATE | CLOCK SOURCE ------------| DIVIDER VALUE */
					(CGU_AXI_CLK			| CLK_ENABLE | AXI_FIX_PLL_CLK400 		| 0)
//					(CGU_SYS_CLK			| CLK_ENABLE | SYS_ADC_PLL_CLK300 		| 1)
					(CGU_ISP_CLK			| CLK_ENABLE | ISP_ADC_PLL_CLK600 		| 1)
					(CGU_ISP_HDR_CLK		| CLK_ENABLE | ISP_HDR_FIX_PLL_CLK500		| 0)
					(CGU_VIF_AXI_CLK		| CLK_ENABLE | VIF_AXI_ADC_PLL_CLK600		| 1)
					(CGU_DLA_CLK			| CLK_ENABLE | DLA_FIX_PLL_CLK500		| 0)
					(CGU_RSZ_CLK			| CLK_ENABLE | RSZ_FIX_PLL_CLK500		| 0)
					(CGU_DE_CLK				| CLK_ENABLE | DE_FIX_PLL_CLK500		| 1)
					(CGU_VENC_CLK			| CLK_ENABLE | VENC_ADC_PLL_CLK600		| 1)
					(CGU_JPEG_CLK			| CLK_ENABLE | JPEG_ADC_PLL_CLK600		| 1)
					(CGU_MIPI_CSI_0_CLK		| CLK_ENABLE | MIPI_CSI_0_FIX_PLL_CLK400	| 1)
					(CGU_MIPI_CSI_1_CLK		| CLK_ENABLE | MIPI_CSI_1_FIX_PLL_CLK400	| 1)
					(CGU_MIPI_PCS_CLK		| CLK_ENABLE | MIPI_PCS_FIX_PLL_CLK333		| 0)
					(CGU_QSPI_CLK			| CLK_ENABLE | QSPI_ADC_PLL_CLK600		| 0)
					(CGU_I2S_MCLK			| CLK_ENABLE | I2S_AUDIO_PLL_CLK		| 0)
					(CGU_I2S_MST0_SCLK		| CLK_ENABLE | I2S_MST0_CGU_I2S_MCLK		| 0)
					(CGU_I2S_MST1_SCLK		| CLK_ENABLE | I2S_MST0_CGU_I2S_MCLK		| 0)
					(CGU_USB_PHY0_CLK		| CLK_ENABLE | USB_PHY0_CGU_OSCIN_CLK		| 0)
					(CGU_AUDIO_300M			| CLK_ENABLE | AUDIO_300M_CLK_AUDIO_DIG		| 0)
					(CGU_GMAC_CORE_CLK		| CLK_ENABLE | GMAC_CORE_FIX_PLL_CLK500		| 1)
					(CGU_GMAC_PHY_CLK		| CLK_ENABLE | GMAC_PHY_FIX_PLL_CLK500		| 9)
					(CGU_HDECOMP_CLK		| CLK_ENABLE | HDECOMP_FIX_PLL_CLK666		| 1)
					(CGU_EFUSE_CLK			| CLK_ENABLE | EFUSE_FIX_PLL_CLK100		| 0)
					(CGU_SENSOR_MCLK0		| CLK_ENABLE | SENSOR0_PIXEL_PLL_CLK1		| 0)
					(CGU_SENSOR_MCLK1		| CLK_ENABLE | SENSOR1_PIXEL_PLL_CLK1		| 0)
					(CGU_SENSOR_MCLK2		| CLK_ENABLE | SENSOR2_PIXEL_PLL_CLK1		| 0)
					(CGU_DVP_PATTERN_CLK		| CLK_ENABLE | DVP_PIXEL_PLL_CLK2		| 0)
					(CGU_DVP_SUB_1_2X_PIX_CLK	| CLK_ENABLE | DVP_PIXEL_PLL_CLK3		| 0)
					(CGU_NUC_CLK			| CLK_ENABLE | NUC_ADC_PLL_CLK600		| 1)
					(CGU_SCGMAC_PTP_CLK		| CLK_ENABLE | SCGMAC_PTP_FIX_PLL_CLK250	| 1)
					(CGU_SCGMAC_RGMIITX_CLK		| CLK_ENABLE | SCGMAC_RGMIITX_FIX_PLL_CLK250	| 1)
					(CGU_SCGMAC_MDC_CLK		| CLK_ENABLE | SCGMAC_MDC_ADC_PLL_CLK50		| 9)
					(CGU_NPU_CLK			| CLK_ENABLE | NPU_FIX_PLL_CLK500		| 0)
					(CGU_NPU_ACLK			| CLK_ENABLE | NPU_FIX_PLL_CLK500		| 0)
					(CGU_IFC_CLK			| CLK_ENABLE | IFC_FIX_PLL_CLK500		| 0)
					(CGU_EIS_CLK			| CLK_ENABLE | EIS_FIX_PLL_CLK500		| 0)
					(CGU_SCALER_CLK			| CLK_ENABLE | SCALER_FIX_PLL_CLK500		| 0)
					(CGU_GEN_CLK			| CLK_ENABLE | GEN_FIX_PLL_CLK100		| 1)
					(CGU_CPU_CLK			| CLK_ENABLE | CPU_FIX_PLL_CLK800		| 0)
					(CGU_CS_DBG_CLK			| CLK_ENABLE | CPU_CGU_OSCIN_CLK		| 0)>;
	};
};
